//
//  Copyright (c) 2023, Alexander Hude
//  All rights reserved.
//

#include "Inkplate.h"
#include "Fonts/FreeSansBoldOblique24pt7b.h"
#include "Fonts/FreeSerifBoldItalic24pt7b.h"
#include "Fonts/FreeSansBold18pt7b.h"
#include "Fonts/FreeSansBold12pt7b.h"
#include "Fonts/FreeMonoBold12pt7b.h"

#include "EventManagerDelegate.hpp"
#include "ProfileManagerDelegate.hpp"
#include "ScreenTimeView.hpp"

#include "helper.hpp"

const unsigned char ScreenTimeView::s_backIcon [] PROGMEM = {
	0xff, 0xff, 0xff, 0xff, 0xff, 0xff, 0xff, 0xf0, 0xff, 0xff, 0xff, 0xff, 0xff, 0xff, 0xff, 0xf0, 
	0xff, 0xff, 0xff, 0xff, 0xff, 0xff, 0xff, 0xf0, 0xff, 0xff, 0xff, 0xff, 0xff, 0xff, 0xff, 0xf0, 
	0xff, 0xff, 0xff, 0xff, 0xff, 0xff, 0xff, 0xf0, 0xff, 0xff, 0xff, 0xff, 0xff, 0xff, 0xff, 0xf0, 
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	0xff, 0xff, 0xff, 0xff, 0xff, 0xff, 0xff, 0xf0, 0xff, 0xff, 0xff, 0xff, 0xff, 0xff, 0xff, 0xf0
};

const unsigned char ScreenTimeView::s_editIcon [] PROGMEM = {
	0xff, 0xff, 0xff, 0xff, 0xff, 0xff, 0xff, 0xf0, 0xff, 0xff, 0xff, 0xff, 0xff, 0xff, 0xff, 0xf0, 
	0xff, 0xff, 0xff, 0xff, 0xff, 0xff, 0xff, 0xf0, 0xff, 0xff, 0xff, 0xff, 0xff, 0xff, 0xff, 0xf0, 
	0xff, 0xff, 0xff, 0xff, 0xff, 0xff, 0xff, 0xf0, 0xff, 0xff, 0xff, 0xff, 0xff, 0xf9, 0xff, 0xf0, 
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	0xff, 0xff, 0xff, 0xff, 0xff, 0xff, 0xff, 0xf0, 0xff, 0xff, 0xff, 0xff, 0xff, 0xff, 0xff, 0xf0
};

const unsigned char ScreenTimeView::s_importIcon [] PROGMEM = {
	0xff, 0x00, 0x00, 0x00, 0x00, 0x7f, 0xff, 0xf0, 0xfe, 0x00, 0x00, 0x00, 0x00, 0x3f, 0xff, 0xf0, 
	0xfe, 0x00, 0x00, 0x00, 0x00, 0x1f, 0xff, 0xf0, 0xfe, 0x00, 0x00, 0x00, 0x00, 0x0f, 0xff, 0xf0, 
	0xfe, 0x00, 0x00, 0x00, 0x00, 0x07, 0xff, 0xf0, 0xfe, 0x00, 0x00, 0x00, 0x00, 0x03, 0xff, 0xf0, 
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	0xff, 0xff, 0xc1, 0xff, 0x00, 0x00, 0x00, 0x10, 0xff, 0xff, 0xf7, 0xff, 0x80, 0x00, 0x00, 0x30
};

void ScreenTimeView::setProfileDelegate(ProfileManagerDelegate* delegate) {
	m_profileDelegate = delegate;
}

bool ScreenTimeView::showsDialog() {
	return m_showEditDialog || m_showOKDialog;
}

void ScreenTimeView::showEditDialog() {
    m_timeEditDialog.reset();
    m_showEditDialog = true;
    m_cacheView = true;
}

void ScreenTimeView::hideEditDialog(bool pass) {
    m_showEditDialog = false;
    if (pass)
        m_editPass();
    else
        m_editFail();
}

void ScreenTimeView::showOKDialog() {
    m_showOKDialog = true;
    m_cacheView = true;
}

void ScreenTimeView::hideOKDialog() {
    m_showOKDialog = false;
}

void ScreenTimeView::create(int width, int height) {
    m_menuSplit.setXYpos(0, 0);
    m_menuSplit.setArea(width, height);
    m_menuSplit.setOffset(100);

    m_headerSplit.setXYpos(0, 0);
    m_headerSplit.setArea(m_menuSplit.getLeftWidth(), height);
    m_headerSplit.setOffset(80);

    m_menuBack.setXYpos(m_menuSplit.getLeftWidth() + 10, 30);
    m_menuBack.setIcon(s_backIcon);
    m_menuBack.setAction([this] () {
        if (m_eventDelegate)
            m_eventDelegate->menuBackToMainPressed();
    });

    m_menuName.setXYpos(m_headerSplit.getXpos()+30, m_headerSplit.getYpos() + 60);
    m_menuName.setFont(&FreeSansBoldOblique24pt7b);
	m_menuName.setText("ScreenTime");

	m_profileSplit.setXYpos(0, m_headerSplit.getTopHeight());
	m_profileSplit.setArea(m_menuSplit.getLeftWidth(), m_headerSplit.getBottomHeight());

    int p_xbase = m_profileSplit.getXpos();

    for (int p = 0; p < m_maxProfileCount; p++) {

		m_timeSplit[p].setXYpos(p_xbase, m_profileSplit.getYpos());
	   	m_timeSplit[p].setArea(m_profileSplit.getLeftWidth(), m_headerSplit.getBottomHeight());
    	m_timeSplit[p].setOffset(210);

		// profile name
	    int p_ybase = m_profileSplit.getYpos();
        m_names[p].setXYpos(p_xbase + 30, p_ybase + 60);
        m_names[p].setDataProvider([p, this] () -> const char* {
            if (m_profileDelegate) {
                return m_profileDelegate->getName(p);
            }
            return nullptr;
        });

		// remain time
		m_remainTime[p].setXYpos(p_xbase + m_profileSplit.getLeftWidth() - 150, p_ybase + 25);
		m_remainTime[p].setDigitSize(40);
		m_remainTime[p].setDataProvider([p, this] () -> int {
			if (m_profileDelegate)
				return m_profileDelegate->getRemainTime(p);
			return 0;
		});

		// adjust 10 mins
		p_ybase += 100;
		m_changeButtons[p][0].setXYpos(p_xbase + 30, p_ybase);
		m_changeButtons[p][0].setText("-");
		m_changeButtons[p][0].setAction([p, this] () {
			if (m_eventDelegate)
				m_eventDelegate->screentimeRemoveMinutes(p, 10);
		});
		m_changeButtons[p][1].setXYpos(p_xbase + m_profileSplit.getLeftWidth() - m_changeButtons[p][0].getWidth() - 30, p_ybase);
		m_changeButtons[p][1].setText("+");
		m_changeButtons[p][1].setAction([p, this] () {
			if (m_eventDelegate)
				m_eventDelegate->screentimeAddMinutes(p, 10);
		});

		m_changeLabels[p][0].setXYpos(p_xbase + 30 + m_changeButtons[p][0].getWidth() + 30, p_ybase+m_changeButtons[p][0].getHeight() - 30);
		m_changeLabels[p][0].setFont(&FreeSansBold18pt7b);
		m_changeLabels[p][0].setText("10 minutes");

		// adjust 1 hour
		p_ybase += m_changeButtons[p][0].getHeight() + 30;
		m_changeButtons[p][2].setXYpos(p_xbase + 30, p_ybase);
		m_changeButtons[p][2].setText("-");
		m_changeButtons[p][2].setAction([p, this] () {
			if (m_eventDelegate)
				m_eventDelegate->screentimeRemoveMinutes(p, 60);
		});
		m_changeButtons[p][3].setXYpos(p_xbase + m_profileSplit.getLeftWidth() - m_changeButtons[p][2].getWidth() - 30, p_ybase);
		m_changeButtons[p][3].setText("+");
		m_changeButtons[p][3].setAction([p, this] () {
			if (m_eventDelegate)
				m_eventDelegate->screentimeAddMinutes(p, 60);
		});

		m_changeLabels[p][1].setXYpos(p_xbase + 30 + m_changeButtons[p][2].getWidth() + 70, p_ybase+m_changeButtons[p][2].getHeight() - 30);
		m_changeLabels[p][1].setFont(&FreeSansBold18pt7b);
		m_changeLabels[p][1].setText("1 hour");

		// set total time
		p_ybase += m_changeButtons[p][2].getHeight() + 50;
		m_totalTimeLabel[p].setXYpos(p_xbase + 30, p_ybase);
		m_totalTimeLabel[p].setFont(&FreeSansBold12pt7b);
		m_totalTimeLabel[p].setText("Total time per week (mins)");
		p_ybase += 15;
		m_totalTimeEdit[p].setXYpos(p_xbase + 30, p_ybase);
		m_totalTimeEdit[p].setWidth(300);
		m_totalTimeEdit[p].setTextLimit(3);
		m_totalTimeEdit[p].hideDeleteButton(true);
		m_totalTimeEdit[p].setDataProvider([p, this] () -> const char* {
			if (m_profileDelegate)
				return m_profileDelegate->getTotalTimeString(p);
			return nullptr;
		});
		m_totalTimeButton[p].setXYpos(m_changeButtons[p][3].getXpos(), p_ybase);
		m_totalTimeButton[p].setIcon(s_editIcon);
		m_totalTimeButton[p].setAction([p, this] () {
			if (m_eventDelegate) {
				m_editPass = [p, this] () {
					if (m_eventDelegate) {
						char* timeStr = m_timeEditDialog.getText();
						int time = atoi(timeStr);
						m_eventDelegate->screentimeSetTotalTime(p, time);
					}
				};
				m_editFail = [this] () {
				};
				m_eventDelegate->editDialogShow();
			}
		});

		p_ybase = m_timeSplit[p].getYpos() + m_timeSplit[p].getTopHeight() + 30;

		m_importHeader[p].setXYpos(p_xbase + 30, p_ybase + 20);
		m_importHeader[p].setFont(&FreeSansBold12pt7b);
		m_importHeader[p].setText("Import profile data from");

		m_import[p].setXYpos(p_xbase + m_profileSplit.getLeftWidth() - 30 - 80, p_ybase);
		m_import[p].setIcon(s_importIcon);
		m_import[p].setAction([p, this] () {
			if (m_eventDelegate) {
				const char* errStr = "Internal Error";
				bool res = m_eventDelegate->profileImportProfile(p, &errStr);
				if (!res) {
					m_okDialog.setHeaderText("Error");
					m_okDialog.setInfoText(errStr);
				} else {
					m_okDialog.setHeaderText("Info");
					m_okDialog.setInfoText("Import complete");
				}
				m_eventDelegate->okDialogShow();
			}
		});

		p_ybase += 60;

		sprintf(m_importNameText[p], "/profile%.2d.txt", p);
		m_importName[p].setXYpos(p_xbase + 30, p_ybase);
		m_importName[p].setFont(&FreeMonoBold12pt7b);
		m_importName[p].setText(m_importNameText[p]);

		p_xbase += m_profileSplit.getLeftWidth();
	}

    m_timeEditDialog.setEventDelegate(m_eventDelegate);
    m_timeEditDialog.create(width, height);
    m_timeEditDialog.setHeaderText("Enter minutes");
	m_timeEditDialog.setTextLimit(3);
    m_timeEditDialog.setActions([this] () {
        if (m_eventDelegate)
            m_eventDelegate->editDialogHide(m_timeEditDialog.getText()); 
    },
    [this] () {
        if (m_eventDelegate)
            m_eventDelegate->editDialogHide(nullptr); 
    });

    m_okDialog.setEventDelegate(m_eventDelegate);
    m_okDialog.create(width, height);
    m_okDialog.setActions([this] () {
        if (m_eventDelegate)
            m_eventDelegate->okDialogHide(); 
    });
}

bool ScreenTimeView::render(Inkplate* context) {
    bool renderView = true;
    bool forceCache = false;

    if (m_showEditDialog || m_showOKDialog)
        renderView = false;

    if (m_cacheView) {
        renderView = true;
        forceCache = true;
    }

	if (renderView) {
		m_menuSplit.render(context);
		m_headerSplit.render(context);
		m_menuName.render(context);
		m_menuBack.render(context);
		m_profileSplit.render(context);
		for (int p = 0; p < m_maxProfileCount; p++) {
			m_timeSplit[p].render(context);
			m_names[p].render(context);
			m_remainTime[p].render(context);
			for (int b = 0; b < 4; b++) {
				m_changeButtons[p][b].render(context);
			}
			for (int l = 0; l < 2; l++) {
				m_changeLabels[p][l].render(context);
			}
			m_totalTimeLabel[p].render(context);
			m_totalTimeEdit[p].render(context);
			m_totalTimeButton[p].render(context);
			m_importHeader[p].render(context);
			m_import[p].render(context);
			m_importName[p].render(context);
		}

	    if (m_cacheView) {
			if (m_showEditDialog) {
	            m_timeEditDialog.clearBackground(context);
				m_timeEditDialog.render(context);
			} else if (m_showOKDialog) {
                m_okDialog.clearBackground(context);
                m_okDialog.render(context);
			}
            m_cacheView = false;
        }
    } else {
        if (m_showEditDialog) {
	        m_timeEditDialog.render(context);
        } else if (m_showOKDialog) {
			m_okDialog.render(context);
		}
    }

	return forceCache;
}

bool ScreenTimeView::touch(Inkplate* context) {
    bool res = false;
	if (m_showEditDialog) {
        res |= m_timeEditDialog.touch(context);
    } else if (m_showOKDialog) {
        res |= m_okDialog.touch(context);
    } else {
		res |= m_menuBack.touch(context);
		for (int p = 0; p < m_maxProfileCount; p++) {
			for (int b = 0; b < 4; b++) {
				res |= m_changeButtons[p][b].touch(context);
			}
			res |= m_totalTimeButton[p].touch(context);
			res |= m_import[p].touch(context);
		}
	}
    return res;
}