//
//  Copyright (c) 2023, Alexander Hude
//  All rights reserved.
//

#include "Inkplate.h"
#include "Fonts/FreeSansBoldOblique24pt7b.h"
#include "Fonts/FreeSerifBoldItalic24pt7b.h"
#include "Fonts/FreeSansBold12pt7b.h"

#include "EventManagerDelegate.hpp"
#include "ProfileManagerDelegate.hpp"
#include "TokensView.hpp"
#include "helper.hpp"

const unsigned char TokensView::s_backIcon [] PROGMEM = {
	0xff, 0xff, 0xff, 0xff, 0xff, 0xff, 0xff, 0xf0, 0xff, 0xff, 0xff, 0xff, 0xff, 0xff, 0xff, 0xf0, 
	0xff, 0xff, 0xff, 0xff, 0xff, 0xff, 0xff, 0xf0, 0xff, 0xff, 0xff, 0xff, 0xff, 0xff, 0xff, 0xf0, 
	0xff, 0xff, 0xff, 0xff, 0xff, 0xff, 0xff, 0xf0, 0xff, 0xff, 0xff, 0xff, 0xff, 0xff, 0xff, 0xf0, 
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	0xff, 0xff, 0xff, 0xff, 0xff, 0xff, 0xff, 0xf0, 0xff, 0xff, 0xff, 0xff, 0xff, 0xff, 0xff, 0xf0
};

const unsigned char TokensView::s_tokenParentHelpIcon [] PROGMEM = {
	0xff, 0xff, 0xff, 0xff, 0xff, 0xff, 0xff, 0xf0, 0xff, 0xff, 0xff, 0xff, 0xff, 0xff, 0xff, 0xf0, 
	0xff, 0xff, 0xff, 0xff, 0xff, 0xff, 0xff, 0xf0, 0xff, 0xff, 0xff, 0xff, 0xff, 0xff, 0xff, 0xf0, 
	0xff, 0xff, 0xff, 0xff, 0xff, 0xff, 0xff, 0xf0, 0xff, 0xff, 0xff, 0xff, 0xff, 0xff, 0xff, 0xf0, 
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	0xff, 0xff, 0xff, 0xff, 0xff, 0xff, 0xff, 0xf0, 0xff, 0xff, 0xff, 0xff, 0xff, 0xff, 0xff, 0xf0
};

const unsigned char TokensView::s_tokenEducationIcon [] PROGMEM = {
	0xff, 0xff, 0xff, 0xff, 0xff, 0xff, 0xff, 0xf0, 0xff, 0xff, 0xff, 0xff, 0xff, 0xff, 0xff, 0xf0, 
	0xff, 0xff, 0xff, 0xff, 0xff, 0xff, 0xff, 0xf0, 0xff, 0xff, 0xff, 0xff, 0xff, 0xff, 0xff, 0xf0, 
	0xff, 0xff, 0xff, 0xff, 0xff, 0xff, 0xff, 0xf0, 0xff, 0xff, 0xff, 0xff, 0xff, 0xff, 0xff, 0xf0, 
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	0xff, 0xff, 0xff, 0xff, 0xff, 0xff, 0xff, 0xf0, 0xff, 0xff, 0xff, 0xff, 0xff, 0xff, 0xff, 0xf0
};

const unsigned char TokensView::s_tokenCreativityIcon [] PROGMEM = {
	0xff, 0xff, 0xff, 0xf9, 0xff, 0xff, 0xff, 0xf0, 0xff, 0xff, 0xff, 0xf9, 0xff, 0xff, 0xff, 0xf0, 
	0xff, 0xff, 0xff, 0xf9, 0xff, 0xff, 0xff, 0xf0, 0xff, 0xff, 0xff, 0xf9, 0xff, 0xff, 0xff, 0xf0, 
	0xff, 0xff, 0xff, 0xf9, 0xff, 0xff, 0xff, 0xf0, 0xff, 0xff, 0xff, 0xf9, 0xff, 0xff, 0xff, 0xf0, 
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	0xff, 0xff, 0xff, 0xc0, 0x3f, 0xff, 0xff, 0xf0, 0xff, 0xff, 0xff, 0xf9, 0xff, 0xff, 0xff, 0xf0
};

const unsigned char TokensView::s_tokenHousekeepingIcon [] PROGMEM = {
	0xff, 0xff, 0xff, 0xff, 0xff, 0xc3, 0xff, 0xf0, 0xff, 0xff, 0xff, 0xff, 0xff, 0x83, 0xff, 0xf0, 
	0xff, 0xff, 0xff, 0xff, 0xff, 0x99, 0xff, 0xf0, 0xff, 0xff, 0xff, 0xff, 0xff, 0x99, 0xff, 0xf0, 
	0xff, 0xff, 0xff, 0xff, 0xff, 0x99, 0xff, 0xf0, 0xff, 0xff, 0xff, 0xff, 0xff, 0x99, 0xff, 0xf0, 
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	0xfe, 0x00, 0x00, 0x00, 0x00, 0x00, 0x00, 0x10, 0xff, 0x00, 0x00, 0x00, 0x00, 0x00, 0x00, 0x30
};

const unsigned char TokensView::s_tokenMiscIcon [] PROGMEM = {
	0xff, 0xff, 0xff, 0x80, 0x1f, 0xff, 0xff, 0xf0, 0xff, 0xff, 0xf8, 0x00, 0x01, 0xff, 0xff, 0xf0, 
	0xff, 0xff, 0xc0, 0x00, 0x00, 0x3f, 0xff, 0xf0, 0xff, 0xff, 0x00, 0x00, 0x00, 0x0f, 0xff, 0xf0, 
	0xff, 0xfc, 0x00, 0xff, 0xf0, 0x07, 0xff, 0xf0, 0xff, 0xf8, 0x07, 0xff, 0xfe, 0x03, 0xff, 0xf0, 
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	0xff, 0xff, 0xf8, 0x00, 0x01, 0xff, 0xff, 0xf0, 0xff, 0xff, 0xff, 0x00, 0x1f, 0xff, 0xff, 0xf0
};

const unsigned char TokensView::s_screenTimeIcon [] PROGMEM = {
	0xff, 0xff, 0xff, 0xf8, 0x1f, 0xff, 0xff, 0xf0, 0xff, 0xff, 0xff, 0xf0, 0x01, 0xff, 0xff, 0xf0, 
	0xff, 0xff, 0xff, 0xf0, 0x00, 0x3f, 0xff, 0xf0, 0xff, 0xff, 0xff, 0xf0, 0x00, 0x0f, 0xff, 0xf0, 
	0xff, 0xff, 0xff, 0xf0, 0x00, 0x03, 0xff, 0xf0, 0xff, 0xff, 0xff, 0xf0, 0xf8, 0x01, 0xff, 0xf0, 
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	0xff, 0xff, 0xf8, 0x00, 0x01, 0xff, 0xff, 0xf0, 0xff, 0xff, 0xff, 0x80, 0x1f, 0xff, 0xff, 0xf0
};

const unsigned char TokensView::s_moneyIcon [] PROGMEM = {
	0xff, 0xff, 0xff, 0x80, 0x1f, 0xff, 0xff, 0xf0, 0xff, 0xff, 0xf8, 0x00, 0x01, 0xff, 0xff, 0xf0, 
	0xff, 0xff, 0xc0, 0x00, 0x00, 0x3f, 0xff, 0xf0, 0xff, 0xff, 0x00, 0x06, 0x00, 0x0f, 0xff, 0xf0, 
	0xff, 0xfc, 0x01, 0xff, 0xf8, 0x03, 0xff, 0xf0, 0xff, 0xf8, 0x0f, 0xff, 0xff, 0x01, 0xff, 0xf0, 
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	0xff, 0xff, 0xf8, 0x00, 0x01, 0xff, 0xff, 0xf0, 0xff, 0xff, 0xff, 0x80, 0x1f, 0xff, 0xff, 0xf0
};

const unsigned char TokensView::s_okIcon [] PROGMEM = {
	0xff, 0xff, 0xff, 0xff, 0xff, 0xff, 0xff, 0xf0, 0xff, 0xff, 0xff, 0xff, 0xff, 0xff, 0xff, 0xf0, 
	0xff, 0xff, 0xff, 0xff, 0xff, 0xff, 0xff, 0xf0, 0xff, 0xff, 0xff, 0xff, 0xff, 0xff, 0xff, 0xf0, 
	0xff, 0xff, 0xff, 0xff, 0xff, 0xff, 0xff, 0xf0, 0xff, 0xff, 0xff, 0xff, 0xff, 0xff, 0xff, 0xf0, 
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	0xff, 0xff, 0xff, 0xff, 0xff, 0xff, 0xff, 0xf0, 0xff, 0xff, 0xff, 0xff, 0xff, 0xff, 0xff, 0xf0
};

const unsigned char TokensView::s_cancelIcon [] PROGMEM = {
	0xff, 0xff, 0xff, 0xff, 0xff, 0xff, 0xff, 0xf0, 0xff, 0xff, 0xff, 0xff, 0xff, 0xff, 0xff, 0xf0, 
	0xff, 0xff, 0xff, 0xff, 0xff, 0xff, 0xff, 0xf0, 0xff, 0xff, 0xff, 0xff, 0xff, 0xff, 0xff, 0xf0, 
	0xff, 0xff, 0xff, 0xff, 0xff, 0xff, 0xff, 0xf0, 0xff, 0x8f, 0xff, 0xff, 0xff, 0xff, 0x1f, 0xf0, 
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	0xff, 0xff, 0xff, 0xff, 0xff, 0xff, 0xff, 0xf0, 0xff, 0xff, 0xff, 0xff, 0xff, 0xff, 0xff, 0xf0
};

void TokensView::setProfileDelegate(ProfileManagerDelegate* delegate) {
	m_profileDelegate = delegate;
}

bool TokensView::showsDialog() {
    return m_showAuthDialog;
}

void TokensView::showAuthDialog() {
    m_authDialog.reset();
    m_showAuthDialog = true;
    m_cacheView = true;
}

void TokensView::hideAuthDialog(bool pass) {
    m_showAuthDialog = false;
    if (pass)
        m_authPass();
    else
        m_authFail();
}

void TokensView::showConfirmDialog() {
    m_showConfirmDialog = true;
    m_cacheView = true;
}

void TokensView::hideConfirmDialog(bool pass) {
    m_showConfirmDialog = false;
    if (pass)
        m_confirmPass();
    else
        m_confirmFail();
}

void TokensView::create(int width, int height) {
    m_menuSplit.setXYpos(0, 0);
    m_menuSplit.setArea(width, height);
    m_menuSplit.setOffset(100);

    m_headerSplit.setXYpos(0, 0);
    m_headerSplit.setArea(m_menuSplit.getLeftWidth(), height);
    m_headerSplit.setOffset(80);

    m_menuBack.setXYpos(m_menuSplit.getLeftWidth() + 10, 30);
    m_menuBack.setIcon(s_backIcon);
    m_menuBack.setAction([this] () {
        if (m_eventDelegate)
            m_eventDelegate->menuBackToMainPressed();
    });

    m_menuName.setXYpos(m_headerSplit.getXpos()+30, m_headerSplit.getYpos() + 60);
    m_menuName.setFont(&FreeSansBoldOblique24pt7b);
    m_menuName.setText("Tokens");

	m_profileSplit.setXYpos(0, m_headerSplit.getTopHeight());
	m_profileSplit.setArea(m_menuSplit.getLeftWidth(), m_headerSplit.getBottomHeight());

    int p_xbase = m_profileSplit.getXpos();

	const unsigned char* tokenIcons[TokenType::Count] = {
		s_tokenParentHelpIcon,
		s_tokenEducationIcon,
		s_tokenCreativityIcon,
		s_tokenHousekeepingIcon,
		s_tokenMiscIcon
	};

    for (int p = 0; p < m_maxProfileCount; p++) {
		// profile name
	    int p_ybase = m_profileSplit.getYpos();

		m_requestSplit[p].setXYpos(p_xbase, m_headerSplit.getTopHeight());
		m_requestSplit[p].setArea(m_profileSplit.getRightWidth(), m_headerSplit.getBottomHeight());
		m_requestSplit[p].setOffset(130);

        m_names[p].setXYpos(p_xbase + 30, p_ybase + 60);
        m_names[p].setDataProvider([p, this] () -> const char* {
            if (m_profileDelegate) {
                return m_profileDelegate->getName(p);
            }
            return nullptr;
        });

		m_remainTime[p].setXYpos(p_xbase + m_profileSplit.getLeftWidth() - 150, p_ybase + 25);
		m_remainTime[p].setDigitSize(40);
		m_remainTime[p].setDataProvider([p, this] () -> int {
			if (m_profileDelegate)
				return m_profileDelegate->getRemainTime(p);
			return 0;
		});

		int p_btn_ybase = p_ybase + 90;
		for (unsigned int t = 0; t < TokenType::Count; t++) {
			int p_btn_xbase = p_xbase + 30;

			m_requestButton[p][t].setXYpos(p_btn_xbase, p_btn_ybase);
			m_requestButton[p][t].setIcon(tokenIcons[t]);
			
			m_requestButton[p][t].setAction([p, t, this] () {
				if(m_eventDelegate)
					m_eventDelegate->tokenRequest(p, TokenType(t));
			});
			p_btn_xbase += 20 + m_requestButton[p][t].getWidth();
			
			sprintf(m_requestLabelText[t], "Request Token\n\"%s\"", TokenTypeString[t]);

			m_requestLabel[p][t].setXYpos(p_btn_xbase, p_btn_ybase + 35);
			m_requestLabel[p][t].setWidth(m_profileSplit.getLeftWidth() - 60 - m_requestButton[p][t].getWidth());
			m_requestLabel[p][t].setFont(&FreeSansBold12pt7b);
			m_requestLabel[p][t].setTextAlignment(TextAlignment::Left);
			m_requestLabel[p][t].setText(m_requestLabelText[t]);

			m_pendingLabel[p][t].setXYpos(p_btn_xbase, p_btn_ybase + 45);
			m_pendingLabel[p][t].setFont(&FreeSansBold12pt7b);
			m_pendingLabel[p][t].setText("pending");

			p_btn_xbase += 135;

			m_cancelButton[p][t].setXYpos(p_btn_xbase, p_btn_ybase);
			m_cancelButton[p][t].setIcon(s_cancelIcon);
			m_cancelButton[p][t].setAction([p, t, this] () {
				if(m_eventDelegate)
					m_eventDelegate->tokenCancelRequest(p, TokenType(t));
			});
			p_btn_xbase += 10 + m_cancelButton[p][t].getWidth();

			m_approveButton[p][t].setXYpos(p_btn_xbase, p_btn_ybase);
			m_approveButton[p][t].setIcon(s_okIcon);
			m_approveButton[p][t].setAction([p, t, this] () {
                if (m_eventDelegate) {
                    m_authPass = [p, t, this] () {
                        if (m_eventDelegate) {
                            m_eventDelegate->tokenApproveRequest(p, TokenType(t));
                        }
                    };
                    m_authFail = [this] () {
                    };
                    m_eventDelegate->authDialogShow();
                }
			});

			p_btn_ybase += 90;
		}
		p_ybase += m_requestSplit[p].getTopHeight() + 20;

		m_tokens[p].setXYpos(p_xbase + 30, p_ybase + 20);
        m_tokens[p].setDataProvider([p, this] () -> const char* {
            if (m_profileDelegate)
                return m_profileDelegate->getTokensString(p);
            return nullptr;
        });

		m_convertLabel[p].setXYpos(p_xbase + 30 + 130, p_ybase + 35);
		m_convertLabel[p].setWidth(90);
		m_convertLabel[p].setFont(&FreeSansBold12pt7b);
		m_convertLabel[p].setTextAlignment(TextAlignment::Center);
		m_convertLabel[p].setText("convert\nto");

		m_convertToTime[p].setXYpos(p_xbase + m_profileSplit.getLeftWidth() - 30 - 80 - 10 - 80, p_ybase);
		m_convertToTime[p].setIcon(s_screenTimeIcon);
		m_convertToTime[p].setAction([p, this] {
            if (m_eventDelegate) {
                m_confirmPass = [p, this] () {
                    if (m_eventDelegate) {
        				m_eventDelegate->tokenConvertToMins(p);
                    }
                };
                m_confirmFail = [this] () {
                };
                m_eventDelegate->confirmDialogShow();
            }
		});

		m_convertToMoney[p].setXYpos(p_xbase + m_profileSplit.getLeftWidth() - 30 - 80, p_ybase);
		m_convertToMoney[p].setIcon(s_moneyIcon);
		m_convertToMoney[p].setAction([p, this] {
			//
		});

		p_xbase += m_profileSplit.getLeftWidth();
	}

    m_authDialog.setEventDelegate(m_eventDelegate);
    m_authDialog.create(width, height);
    m_authDialog.setHeaderText("Enter PIN");
    m_authDialog.setTextLimit(6);
    m_authDialog.setSecureMode(true);
    m_authDialog.setActions([this] () {
        if (m_eventDelegate)
            m_eventDelegate->authDialogHide(m_authDialog.getText()); 
    },
    [this] () {
        if (m_eventDelegate)
            m_eventDelegate->authDialogHide(nullptr); 
    });

    m_confirmDialog.setEventDelegate(m_eventDelegate);
    m_confirmDialog.create(width, height);
    m_confirmDialog.setHeaderText("Convert token?");
    m_confirmDialog.setActions([this] () {
        if (m_eventDelegate)
            m_eventDelegate->confirmDialogHide(true); 
    },
    [this] () {
        if (m_eventDelegate)
            m_eventDelegate->confirmDialogHide(false); 
    });
}

bool TokensView::render(Inkplate* context) {
    bool renderView = true;
    bool forceCache = false;

    if (m_showAuthDialog || m_showConfirmDialog)
        renderView = false;

    if (m_cacheView) {
        renderView = true;
        forceCache = true;
    }

	if (renderView) {
		m_menuSplit.render(context);
		m_headerSplit.render(context);
		m_menuName.render(context);
		m_menuBack.render(context);
		m_profileSplit.render(context);
		for (int p = 0; p < m_maxProfileCount; p++) {
			if (m_profileDelegate) {
				if (!m_profileDelegate->isActive(p))
					continue;
			}

			m_names[p].render(context);
			m_remainTime[p].render(context);
			for (unsigned int t = 0; t < TokenType::Count; t++) {
				m_requestSplit[p].render(context);
				bool tokenRequested = false;
				if (m_profileDelegate)
					tokenRequested = m_profileDelegate->tokenTypeRequested(p, TokenType(t));
				m_requestButton[p][t].setDisabled(tokenRequested);
				m_requestButton[p][t].render(context);
				if (tokenRequested) {
					m_pendingLabel[p][t].render(context);
					m_cancelButton[p][t].setDisabled(false);
					m_cancelButton[p][t].render(context);
					m_approveButton[p][t].setDisabled(false);
					m_approveButton[p][t].render(context);
				} else {
					m_requestLabel[p][t].render(context);
					m_cancelButton[p][t].setDisabled(true);
					m_approveButton[p][t].setDisabled(true);
				}
			}
			m_tokens[p].render(context);
			int tokens = 0;
			if (m_profileDelegate)
				tokens = m_profileDelegate->getTokens(p);
			m_convertToTime[p].setDisabled(tokens == 0);
			m_convertLabel[p].render(context);
			m_convertToTime[p].render(context);
			m_convertToMoney[p].setDisabled(true);
			m_convertToMoney[p].render(context);
		}

        if (m_cacheView) {
            if (m_showAuthDialog) {
                m_authDialog.clearBackground(context);
                m_authDialog.render(context);
            } else if (m_showConfirmDialog) {
                m_confirmDialog.clearBackground(context);
                m_confirmDialog.render(context);
            }
            m_cacheView = false;
        }
	} else {
        if (m_showAuthDialog) {
    		m_authDialog.render(context);
        } else if (m_showConfirmDialog) {
    		m_confirmDialog.render(context);
        }
	}

	return forceCache;
}

bool TokensView::touch(Inkplate* context) {
    bool res = false;
	if (m_showAuthDialog) {
        res |= m_authDialog.touch(context);
    } else if (m_showConfirmDialog) {
        res |= m_confirmDialog.touch(context);
    } else {
		res |= m_menuBack.touch(context);
		res |= m_menuBack.touch(context);
		for (int p = 0; p < m_maxProfileCount; p++) {
			for (unsigned int t = 0; t < TokenType::Count; t++) {
				res |= m_requestButton[p][t].touch(context);
				res |= m_cancelButton[p][t].touch(context);
				res |= m_approveButton[p][t].touch(context);
			}
			res |= m_convertToTime[p].touch(context);
			res |= m_convertToMoney[p].touch(context);
		}
    }
    return res;
}