//
//  Copyright (c) 2023, Alexander Hude
//  All rights reserved.
//

#include "Inkplate.h"
#include "Fonts/FreeSerifBold24pt7b.h"

#include "MainView.hpp"
#include "Profile.hpp"
#include "SystemCoreDelegate.hpp"
#include "EventManagerDelegate.hpp"
#include "ProfileManagerDelegate.hpp"
#include "helper.hpp"

const unsigned char MainView::s_screenTimeIcon [] PROGMEM = {
	0xff, 0xff, 0xff, 0xf8, 0x1f, 0xff, 0xff, 0xf0, 0xff, 0xff, 0xff, 0xf0, 0x01, 0xff, 0xff, 0xf0, 
	0xff, 0xff, 0xff, 0xf0, 0x00, 0x3f, 0xff, 0xf0, 0xff, 0xff, 0xff, 0xf0, 0x00, 0x0f, 0xff, 0xf0, 
	0xff, 0xff, 0xff, 0xf0, 0x00, 0x03, 0xff, 0xf0, 0xff, 0xff, 0xff, 0xf0, 0xf8, 0x01, 0xff, 0xf0, 
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	0xff, 0xff, 0xf8, 0x00, 0x01, 0xff, 0xff, 0xf0, 0xff, 0xff, 0xff, 0x80, 0x1f, 0xff, 0xff, 0xf0
};

const unsigned char MainView::s_tokensIcon [] PROGMEM = {
	0xff, 0xff, 0xff, 0x80, 0x1f, 0xff, 0xff, 0xf0, 0xff, 0xff, 0xf8, 0x00, 0x01, 0xff, 0xff, 0xf0, 
	0xff, 0xff, 0xe0, 0x00, 0x00, 0x7f, 0xff, 0xf0, 0xff, 0xff, 0x80, 0x00, 0x00, 0x1f, 0xff, 0xf0, 
	0xff, 0xfe, 0x00, 0xff, 0xf0, 0x07, 0xff, 0xf0, 0xff, 0xfc, 0x07, 0xff, 0xfe, 0x03, 0xff, 0xf0, 
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	0xff, 0xe1, 0xff, 0xff, 0xff, 0xf8, 0x7f, 0xf0, 0xff, 0xe3, 0xff, 0xff, 0xff, 0xfc, 0x7f, 0xf0
};

const unsigned char MainView::s_todoListIcon [] PROGMEM = {
	0xff, 0xff, 0xff, 0xf0, 0xff, 0xff, 0xff, 0xf0, 0xff, 0xff, 0xff, 0xc0, 0x3f, 0xff, 0xff, 0xf0, 
	0xff, 0xff, 0xff, 0x80, 0x1f, 0xff, 0xff, 0xf0, 0xff, 0xff, 0xff, 0x00, 0x0f, 0xff, 0xff, 0xf0, 
	0xff, 0xff, 0x00, 0x06, 0x00, 0x0f, 0xff, 0xf0, 0xff, 0xfc, 0x00, 0x0f, 0x00, 0x03, 0xff, 0xf0, 
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	0xfc, 0x00, 0x00, 0x00, 0x00, 0x00, 0x03, 0xf0, 0xff, 0x00, 0x00, 0x00, 0x00, 0x00, 0x0f, 0xf0
};

const unsigned char MainView::s_settingsIcon [] PROGMEM = {
	0xff, 0xff, 0xff, 0xff, 0xff, 0xff, 0xff, 0xf0, 0xff, 0xff, 0xff, 0xc0, 0x3f, 0xff, 0xff, 0xf0, 
	0xff, 0xff, 0xff, 0x00, 0x0f, 0xff, 0xff, 0xf0, 0xff, 0xff, 0xff, 0x00, 0x0f, 0xff, 0xff, 0xf0, 
	0xff, 0xff, 0xff, 0x00, 0x0f, 0xff, 0xff, 0xf0, 0xff, 0xfe, 0xff, 0x0f, 0x0f, 0xf7, 0xff, 0xf0, 
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	0xff, 0xff, 0xff, 0x7f, 0xef, 0xff, 0xff, 0xf0, 0xff, 0xff, 0xff, 0xff, 0xff, 0xff, 0xff, 0xf0
};

void MainView::setSystemCoreDelegate(SystemCoreDelegate* delegate) {
    m_systemCoreDelegate = delegate;
}

void MainView::setProfileDelegate(ProfileManagerDelegate* delegate) {
    m_profileDelegate = delegate;
}

bool MainView::showsDialog() {
    return m_showAuthDialog;
}

void MainView::showAuthDialog() {
    m_authDialog.reset();
    m_showAuthDialog = true;
    m_cacheView = true;
}

void MainView::hideAuthDialog(bool pass) {
    m_showAuthDialog = false;
    if (pass)
        m_authPass();
    else
        m_authFail();
}

void MainView::create(int width, int height) {
    m_menuSplit.setXYpos(0, 0);
    m_menuSplit.setArea(width, height);
    m_menuSplit.setOffset(100);
    m_profileSplit.setXYpos(0, 0);
    m_profileSplit.setArea(m_menuSplit.getLeftWidth(), height);

    int pad = 30;
    int p_xbase = pad;
    int p_ybase = 0;

    for (int p = 0; p < m_maxProfileCount; p++) {
        m_listSplit[p].setXYpos(0, p_ybase);
        m_listSplit[p].setArea(m_menuSplit.getLeftWidth(), m_profileSplit.getTopHeight());
        m_listSplit[p].setOffset(530);

        m_names[p].setXYpos(p_xbase + 10, p_ybase + 60);
        m_names[p].setDataProvider([p, this] () -> const char* {
            if (m_profileDelegate) {
                return m_profileDelegate->getName(p);
            }
            return nullptr;
        });

        m_radialTimers[p].setXYpos(p_xbase, p_ybase + 90);
        m_radialTimers[p].setDataProvider([p, this] () -> int {
            if (m_profileDelegate)
                return m_profileDelegate->getTotalTime(p);
            return 0;
        }, [p, this] () -> int{
            if (m_profileDelegate)
                return m_profileDelegate->getRemainTime(p);
            return 0;
        }, [p, this] () -> int{
            if (m_profileDelegate)
                return m_profileDelegate->getSessionTime(p);
            return 0;
        }
        );
        
        m_tokens[p].setXYpos(p_xbase + m_radialTimers[p].getWidth() + 50, p_ybase + 90);
        m_tokens[p].setDataProvider([p, this] () -> const char* {
            if (m_profileDelegate)
                return m_profileDelegate->getTokensString(p);
            return nullptr;
        });

        m_timerButtons[p].setXYpos(p_xbase + m_radialTimers[p].getWidth() + 50, p_ybase + 160);
        m_timerButtons[p].setAction([p, this] (bool timerOn) {
            if (m_eventDelegate) {
                if (timerOn)
                    m_eventDelegate->timerStarted(p);
                else
                    m_eventDelegate->timerStopped(p);
            }
        });

        m_activity[p].setXYpos(m_listSplit[p].getLeftWidth(), p_ybase);
        m_activity[p].setWidth(m_listSplit[p].getRightWidth());
        m_activity[p].setHeight(m_profileSplit.getTopHeight());
        m_activity[p].setTimeProvider([p, this] () -> int {
            if (m_systemCoreDelegate)
                return m_systemCoreDelegate->getMinutesForDay(); 
            return -1;
        });
        m_activity[p].setDataProvider([p, this] (int idx, int* mins, const char** text) -> bool {
            if (m_profileDelegate)
                return m_profileDelegate->getActivity(p, idx, mins, text);
            return false; 
        });

        p_ybase += m_profileSplit.getTopHeight();
    }

    m_menuScreentime.setXYpos(m_menuSplit.getLeftWidth() + 10, pad);
    m_menuScreentime.setIcon(s_screenTimeIcon);
    m_menuScreentime.setAction([this] () {
        if (m_eventDelegate) {
            m_authPass = [this] () {
                if (m_eventDelegate) {
                    m_eventDelegate->menuScreenTimePressed();
                }
            };
            m_authFail = [this] () {
            };
            m_eventDelegate->authDialogShow();
        }
    });
    m_menuTokens.setXYpos(m_menuSplit.getLeftWidth() + 10, m_menuScreentime.getYpos() + m_menuScreentime.getHeight() + 15);
    m_menuTokens.setIcon(s_tokensIcon);
    m_menuTokens.setAction([this] () {
        if (m_eventDelegate)
            m_eventDelegate->menuTokensPressed();
    });

    m_menuTodoList.setXYpos(m_menuSplit.getLeftWidth() + 10, m_menuTokens.getYpos() + m_menuTokens.getHeight() + 15);
    m_menuTodoList.setIcon(s_todoListIcon);
    m_menuTodoList.setAction([this] () {
        if (m_eventDelegate)
            m_eventDelegate->menuTodoListPressed();
    });

    m_menuSettings.setXYpos(m_menuSplit.getLeftWidth() + 10, m_menuTodoList.getYpos() + m_menuTodoList.getHeight() + 15);
    m_menuSettings.setIcon(s_settingsIcon);
    m_menuSettings.setAction([this] () {
        if (m_eventDelegate)
            m_eventDelegate->menuSettingsPressed();
    });

    m_time.setXYpos(m_menuSplit.getXpos() + m_menuSplit.getLeftWidth() + 10, height - pad - 20 - 24);
    m_time.setDigitSize(26);
    m_time.setDataProvider([this] () -> int {
        if (m_systemCoreDelegate)
            return m_systemCoreDelegate->getMinutesForDay();
        return 0;
    });

    m_battery.setXYpos(m_menuSplit.getXpos() + m_menuSplit.getLeftWidth() + 35, height - pad - 13);
    m_battery.setDataProvider([this] () -> int {
        if (m_systemCoreDelegate)
            return m_systemCoreDelegate->getBatteryPercent();
        return 0;
    });

    m_authDialog.setEventDelegate(m_eventDelegate);
    m_authDialog.create(width, height);
    m_authDialog.setHeaderText("Enter PIN");
    m_authDialog.setTextLimit(6);
    m_authDialog.setSecureMode(true);
    m_authDialog.setActions([this] () {
        if (m_eventDelegate)
            m_eventDelegate->authDialogHide(m_authDialog.getText()); 
    },
    [this] () {
        if (m_eventDelegate)
            m_eventDelegate->authDialogHide(nullptr); 
    });

    m_errorBanner.create(width, height);
    m_errorBanner.setHeaderText("Error");
    if (m_systemCoreDelegate->getInitError() != nullptr) {
        m_errorBanner.setInfoText(m_systemCoreDelegate->getInitError());
        m_showErrorBanner = true;
    }
}

bool MainView::render(Inkplate* context) {
    bool renderView = true;
    bool forceCache = false;

    if (m_showErrorBanner) {
        m_errorBanner.render(context);
        return forceCache;
    }


    if (m_showAuthDialog)
        renderView = false;

    if (m_cacheView) {
        renderView = true;
        forceCache = true;
    }

    if (renderView) {
        m_menuSplit.render(context);
        m_profileSplit.render(context);
        for (int p = 0; p < m_maxProfileCount; p++) {
            m_listSplit[p].render(context);
        }

        for (int p = 0; p < m_maxProfileCount; p++) {
            if (m_profileDelegate) {
                if (!m_profileDelegate->isActive(p))
                    continue;
            }
            m_names[p].render(context);
            m_radialTimers[p].render(context);
            m_tokens[p].render(context);
            m_timerButtons[p].render(context);

            m_activity[p].render(context);
        }

        m_menuScreentime.render(context);
        m_menuTokens.render(context);
        m_menuTodoList.render(context);
        m_menuSettings.render(context);

        m_time.render(context);
        m_battery.render(context);

        if (m_cacheView) {
            m_authDialog.clearBackground(context);
            m_authDialog.render(context);
            m_cacheView = false;
        }
    } else {
        m_authDialog.render(context);
    }

    return forceCache;
}

bool MainView::touch(Inkplate* context) {
    bool res = false;
    if (m_showAuthDialog) {
        res |= m_authDialog.touch(context);
    } else {
        res |= m_timerButtons[0].touch(context);
        res |= m_timerButtons[1].touch(context);
        res |= m_menuScreentime.touch(context);
        res |= m_menuTokens.touch(context);
        res |= m_menuTodoList.touch(context);
        res |= m_menuSettings.touch(context);
    }
    return res;
}